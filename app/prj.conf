## CMakeLists.txt
```
cmake_minimum_required(VERSION 3.20)

# for global installs
find_package(Zephyr REQUIRED HINTS $ENV{ZEPHYR_BASE})

# populated the $PROJECT_NAME var and this is what the output files are named 
project(zephyr_shell_template)

# app is a predesignated target that zephyr uses
target_sources(app PRIVATE src/main.c)
```

## Kconfig
```
# Turns on every built-in Zephyr shell command module that makes sense for a
# general purpose board.
#
# 'imply' (instead of setting CONFIG_...=y in prj.conf) means each option is
# only turned on if the board/SoC can actually support it. So the same template
# builds on any board without Kconfig warnings, and you just get the commands
# your hardware has. To turn one off, set it to =n in prj.conf, e.g.
#   CONFIG_CAN_SHELL=n

config APP_ENABLE_ALL_SHELL_CMDS
	bool "Enable all built-in Zephyr shell commands"
	default y
	depends on SHELL
	# --- peripheral subsystems (needed for their shell commands to exist) ---
	imply GPIO
	imply I2C
	imply SPI
	imply ADC
	imply PWM
	imply SENSOR
	imply FLASH
	imply FLASH_PAGE_LAYOUT
	imply FLASH_MAP
	imply COUNTER
	imply WATCHDOG
	imply RTC
	imply EEPROM
	imply LED
	imply REGULATOR
	imply DAC
	imply CAN
	imply I2S
	imply INPUT
	imply HWINFO
	imply COMPARATOR
	imply STATS
	imply CRC
	# --- system / kernel commands ---
	imply KERNEL_SHELL
	imply DEVICE_SHELL
	imply DATE_SHELL
	imply DEVMEM_SHELL
	imply HWINFO_SHELL
	imply STATS_SHELL
	imply CRC_SHELL
	# --- peripheral commands ---
	imply GPIO_SHELL
	imply I2C_SHELL
	imply SPI_SHELL
	imply UART_SHELL
	imply ADC_SHELL
	imply PWM_SHELL
	imply SENSOR_SHELL
	imply FLASH_SHELL
	imply FLASH_MAP_SHELL
	imply COUNTER_SHELL
	imply WDT_SHELL
	imply RTC_SHELL
	imply EEPROM_SHELL
	imply LED_SHELL
	imply REGULATOR_SHELL
	imply DAC_SHELL
	imply CAN_SHELL
	imply I2S_SHELL
	imply INPUT_SHELL
	imply COMPARATOR_SHELL
	imply CLOCK_CONTROL_NRF_SHELL

source "Kconfig.zephyr"
```

## prj.conf
```kconfig
# add desired CONFIGs here

# ---------------------------------------------------------------------------
# Core shell
# ---------------------------------------------------------------------------
# turns on the shell subsystem itself
CONFIG_SHELL=y
# runs the shell over the UART chosen as 'zephyr,shell-uart' in the board dts
CONFIG_SHELL_BACKEND_SERIAL=y
# the shell thread needs more stack than the default once logging/getopt are on
CONFIG_SHELL_STACK_SIZE=4096
# text shown before every command you type
CONFIG_SHELL_PROMPT_UART="zephyr:~$ "
# max length of one typed command line, and max number of words in it
CONFIG_SHELL_CMD_BUFF_SIZE=256
CONFIG_SHELL_ARGC_MAX=20

# ---------------------------------------------------------------------------
# Quality of life features (these make the shell feel like a normal terminal)
# ---------------------------------------------------------------------------
# up/down arrow to scroll through previous commands
CONFIG_SHELL_HISTORY=y
CONFIG_SHELL_HISTORY_BUFFER=1024
# press tab to list/complete commands and subcommands
CONFIG_SHELL_TAB=y
CONFIG_SHELL_TAB_AUTOCOMPLETION=y
# lets you use '*' and '?' in command names (e.g. "log enable dbg *")
CONFIG_SHELL_WILDCARD=y
# ctrl+a, ctrl+e, ctrl+w, ctrl+l etc. like in bash
CONFIG_SHELL_METAKEYS=y
# colored output (errors red, warnings yellow) and cursor movement
CONFIG_SHELL_VT100_COMMANDS=y
CONFIG_SHELL_VT100_COLORS=y
# "help" command and "-h"/"--help" on every command
CONFIG_SHELL_HELP=y
CONFIG_SHELL_HELP_ON_WRONG_ARGUMENT_COUNT=y
# thread safe getopt() so your own commands can parse flags like "-v -n 5"
CONFIG_SHELL_GETOPT=y
# "retval" command prints the return value of the last command you ran
CONFIG_SHELL_CMDS_RETURN_VALUE=y

# ---------------------------------------------------------------------------
# Built-in shell commands
# ---------------------------------------------------------------------------
# clear, history, shell echo/colors/stats/backspace_mode etc.
CONFIG_SHELL_CMDS=y
# "resize" - matches the shell width to your terminal window
CONFIG_SHELL_CMDS_RESIZE=y
# "select" - lets you "cd" into a command so you don't retype the prefix
CONFIG_SHELL_CMDS_SELECT=y
# "shell stats" - counts of dropped log messages etc.
CONFIG_SHELL_STATS=y

# the "kernel" command needs these to show thread names, stack usage and CPU %
CONFIG_THREAD_MONITOR=y
CONFIG_THREAD_NAME=y
CONFIG_THREAD_STACK_INFO=y
CONFIG_INIT_STACKS=y
CONFIG_THREAD_RUNTIME_STATS=y
CONFIG_SCHED_THREAD_USAGE=y
# lets "kernel reboot" work
CONFIG_REBOOT=y

# All the other built-in command modules (kernel, device, gpio, i2c, spi,
# sensor, flash, adc, pwm, ...) are turned on in app/Kconfig, so each one is only
# enabled when your board supports it. Turn one off here with e.g. CONFIG_CAN_SHELL=n

# ---------------------------------------------------------------------------
# Logging (log messages print into the shell without breaking the prompt)
# ---------------------------------------------------------------------------
CONFIG_LOG=y
# sends LOG_INF/LOG_ERR/etc. output through the shell
CONFIG_SHELL_LOG_BACKEND=y
# "log" command - enable/disable/change log levels per module at runtime
CONFIG_LOG_CMDS=y
# the shell already owns the uart, so don't also print logs raw to it
CONFIG_LOG_BACKEND_UART=n
```

## src/main.c
```c
#include <zephyr/kernel.h>
#include <zephyr/logging/log.h>

// registers this file as the "app" log module, so you can run "log enable dbg app" in the shell
LOG_MODULE_REGISTER(app, LOG_LEVEL_INF);

int main(void)
{
    // nothing else is needed to get the shell running: it is started automatically
    // in its own thread by CONFIG_SHELL, and all of its commands come from prj.conf / Kconfig
    LOG_INF("Zephyr shell template started, press tab or type 'help'");

    // main is free to do your application's work here, the shell keeps running alongside it
    // use LOG_INF()/LOG_ERR() instead of printk() so output doesn't break the shell prompt
    return 0;
}
```
